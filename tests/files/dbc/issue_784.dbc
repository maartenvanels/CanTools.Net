VERSION ""

NS_ :

BS_:

BU_: ECU2_123456789012345678901234567 ECU1

BO_ 83 Message_2: 8 ECU2_123456789012345678901234567
 SG_ signal_2 : 0|8@1- (1,0) [0|0] ""  ECU1

BO_ 82 Message_1_1234567890123456789012: 8 ECU1
 SG_ signal_1_12345678901234567890124 : 8|8@1- (1,0) [0|0] ""  ECU2_123456789012345678901234567
 SG_ signal_1_12345678901234567890123 : 0|8@1- (1,0) [0|0] ""  ECU2_123456789012345678901234567

CM_ BU_ ECU1 "First ECU";
BA_DEF_ BO_  "MsgProject" ENUM  "A","B","C";
BA_DEF_  "BusType" STRING ;
BA_DEF_ BO_  "GenMsgCycleTime" INT 0 65535;
BA_DEF_ SG_  "SystemSignalLongSymbol" STRING ;
BA_DEF_ BO_  "SystemMessageLongSymbol" STRING ;
BA_DEF_ BU_  "SystemNodeLongSymbol" STRING ;
BA_DEF_REL_ BU_SG_REL_  "SigFirstTimeoutTime" INT 0 65535;
BA_DEF_REL_ BU_SG_REL_  "SigTimeoutTime" INT 0 65535;
BA_DEF_DEF_  "MsgProject" "A";
BA_DEF_DEF_  "BusType" "";
BA_DEF_DEF_  "GenMsgCycleTime" 0;
BA_DEF_DEF_REL_ "SigFirstTimeoutTime" 0;
BA_DEF_DEF_REL_ "SigTimeoutTime" 0;
BA_DEF_DEF_  "SystemSignalLongSymbol" "";
BA_DEF_DEF_  "SystemMessageLongSymbol" "";
BA_DEF_DEF_  "SystemNodeLongSymbol" "";
BA_ "BusType" "CAN";
BA_ "SystemNodeLongSymbol" BU_ ECU2_123456789012345678901234567 "ECU2_12345678901234567890123456789012";
BA_ "GenMsgCycleTime" BO_ 83 50;
BA_ "SystemMessageLongSymbol" BO_ 82 "Message_1_12345678901234567890123456789012";
BA_ "SystemSignalLongSymbol" SG_ 82 signal_1_12345678901234567890123 "signal_1_12345678901234567890123456789012";
BA_ "SystemSignalLongSymbol" SG_ 82 signal_1_12345678901234567890124 "signal_1_12345678901234567890123456789013";
BA_REL_ "SigFirstTimeoutTime" BU_SG_REL_ ECU2_123456789012345678901234567 SG_ 82 signal_1_12345678901234567890124 24000;
BA_REL_ "SigTimeoutTime" BU_SG_REL_ ECU2_123456789012345678901234567 SG_ 82 signal_1_12345678901234567890124 6000;
